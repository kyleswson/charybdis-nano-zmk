## config/dts/bindings/pixart,pmw3610.yml
```yaml
compatible: "pixart,pmw3610"
description: "PixArt PMW3610 optical motion sensor binding for ZMK/Zephyr"
properties:
  input-processors:
    type: phandle-array
    description: Input processor nodes associated with this input device.
    required: false
```

## config/west.yml
```yaml
manifest:
  remotes:
    - name: zmkfirmware
      url-base: https://github.com/zmkfirmware
    - name: badjeff
      url-base: https://github.com/badjeff
    - name: urob
      url-base: https://github.com/urob
    - name: dhruvinsh
      url-base: https://github.com/dhruvinsh
  projects:
    - name: zmk
      remote: zmkfirmware
      revision: v0.3.0
      import: app/west.yml
    - name: zmk-pmw3610-driver
      remote: badjeff
      revision: main
    - name: zmk-input-processor-report-rate-limit
      remote: badjeff
      revision: main
    - name: zmk-auto-layer
      remote: urob
      revision: v0.3.0 # set to same version as zmk above
    - name: zmk-tri-state
      remote: dhruvinsh
      revision: main
  self:
    path: config
```
